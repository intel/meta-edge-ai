## conf/layer.conf
```bitbake
BBPATH .= ":${LAYERDIR}"

BBFILES += "${LAYERDIR}/recipes-*/*/*.bb \
	${LAYERDIR}/recipes-*/*/*.bbappend"

BBFILE_COLLECTIONS += "meta-edge-ai"
BBFILE_PATTERN_meta-edge-ai = "^${LAYERDIR}/"
BBFILE_PRIORITY_meta-edge-ai = "10"

LAYERSERIES_COMPAT_meta-edge-ai = "warrior"
```
